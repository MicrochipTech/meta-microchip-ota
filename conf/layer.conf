## conf/layer.conf
```bitbake
# We have a conf and classes directory, add to BBPATH
BBPATH .= ":${LAYERDIR}"

# We have recipes-* directories, add to BBFILES
BBFILES += "${LAYERDIR}/recipes-*/*/*.bb \
            ${LAYERDIR}/recipes-*/*/*.bbappend"

BBFILE_COLLECTIONS += "meta-microchip-ota"
BBFILE_PATTERN_meta-microchip-ota = "^${LAYERDIR}/"
BBFILE_PRIORITY_meta-microchip-ota = "11"

LAYERDEPENDS_meta-microchip-ota = "core"
LAYERSERIES_COMPAT_meta-microchip-ota = "kirkstone"
```

## wic/sam9x60-curiosity-sd.wks
```
# short-description: Create SD card image with a dual partition
# long-description: Creates a partitioned SD card image. Boot files
# are located in the first vfat partition.

part /boot --source bootimg-partition --ondisk mmcblk0 --fstype=vfat --label boot --active --align 4 --size 16
part / --source rootfs --ondisk mmcblk0 --fstype=ext4 --label rootfs_A  --align 4
part / --source rootfs --ondisk mmcblk0 --fstype=ext4 --label rootfs_B  --align 4
#part swap --ondisk mmcblk0 --size 44 --label swap --fstype=swap --size=1024M --overhead-factor 1

bootloader --ptable msdos
```
